## tinytrekos/meta-tt/conf/distro/ttos.conf
```bitbake
DISTRO = "ttos"
DISTRO_NAME = "TinyTrekOS"
DISTRO_VERSION = "1.0"
DISTRO_CODENAME = "ttos"

LOCALCONF_VERSION = "2"

DISTRO_FEATURES:append = " multiarch systemd systemd-resolved usbgadget"
DISTRO_EXTRA_RDEPENDS:append = " packagegroup-core-boot"
DISTRO_EXTRA_RRECOMMENDS:append = " kernel-module-af-packet"

# Set the default init manager
VIRTUAL-RUNTIME_init_manager = "systemd"
DISTRO_FEATURES_BACKFILL_CONSIDERED = "sysvinit"
VIRTUAL-RUNTIME_initscripts = ""

# Choose the package management backend
PACKAGE_CLASSES ?= "package_ipk"

# Select init manager
INIT_MANAGER = "systemd"

LICENSE_FLAGS_ACCEPTED = "synaptics-killswitch"
```

## tinytrekos/meta-tt/conf/machine/tinytrek-hw.conf
```bitbake
require conf/machine/raspberrypi4-64.conf

MACHINEOVERRIDES =. "tinytrek-hw:"

# Set up the default tune (architecture)
DEFAULTTUNE = "cortexa72"

MACHINE_ESSENTIAL_EXTRA_RRECOMMENDS += " \
    kernel-modules \
"

RPI_USE_U_BOOT = "1"
IMAGE_INSTALL:append = " kernel-image kernel-devicetree"
```
